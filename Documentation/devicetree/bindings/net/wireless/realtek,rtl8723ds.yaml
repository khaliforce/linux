## Documentation/devicetree/bindings/net/wireless/realtek,rtl8723ds.yaml
```yaml
# SPDX-License-Identifier: (GPL-2.0-only OR BSD-2-Clause)
%YAML 1.2
---
$id: http://devicetree.org/schemas/net/wireless/realtek,rtl8723ds.yaml#
$schema: http://devicetree.org/meta-schemas/core.yaml#

title: Realtek RTL8723DS SDIO Wi-Fi

maintainers:
  - khaliforce <kforce@gmail.com>

description:
  The RTL8723DS provides Wi-Fi over SDIO.

allOf:
  - $ref: wireless-controller.yaml#

properties:
  compatible:
    const: realtek,rtl8723ds

  reg:
    maxItems: 1

  interrupts:
    maxItems: 1

  interrupt-names:
    const: host-wake

required:
  - compatible
  - reg

unevaluatedProperties: false

examples:
  - |
    #include <dt-bindings/interrupt-controller/irq.h>

    mmc {
        #address-cells = <1>;
        #size-cells = <0>;

        wifi@1 {
            compatible = "realtek,rtl8723ds";
            reg = <1>;
            interrupt-parent = <&gpio>;
            interrupts = <10 IRQ_TYPE_LEVEL_LOW>;
            interrupt-names = "host-wake";
        };
    };
```

## Documentation/devicetree/bindings/regulator/allwinner,sun20i-d1-analog-ldos.yaml
```yaml
# SPDX-License-Identifier: (GPL-2.0-only OR BSD-2-Clause)
%YAML 1.2
---
$id: http://devicetree.org/schemas/regulator/allwinner,sun20i-d1-analog-ldos.yaml#
$schema: http://devicetree.org/meta-schemas/core.yaml#

title: Allwinner D1 Analog LDOs

maintainers:
  - Samuel Holland <samuel@sholland.org>

description:
  The codec power register controls the analog and headphone LDOs.
  The SID bandgap trim cell supplies the reference calibration.

properties:
  compatible:
    const: allwinner,sun20i-d1-analog-ldos

  reg:
    maxItems: 1

  nvmem-cells:
    maxItems: 1

  nvmem-cell-names:
    const: bg_trim

  aldo:
    type: object
    $ref: regulator.yaml#
    properties:
      vdd33-supply: true
    unevaluatedProperties: false

  hpldo:
    type: object
    $ref: regulator.yaml#
    properties:
      hpldoin-supply: true
    unevaluatedProperties: false

required:
  - compatible
  - reg
  - nvmem-cells
  - nvmem-cell-names

additionalProperties: false
...
```

## Documentation/devicetree/bindings/sound/allwinner,sun20i-d1-codec.yaml
```yaml
# SPDX-License-Identifier: (GPL-2.0-only OR BSD-2-Clause)
%YAML 1.2
---
$id: http://devicetree.org/schemas/sound/allwinner,sun20i-d1-codec.yaml#
$schema: http://devicetree.org/meta-schemas/core.yaml#

title: Allwinner D1 Internal Audio Codec

maintainers:
  - Samuel Holland <samuel@sholland.org>

allOf:
  - $ref: sound-card-common.yaml#

properties:
  compatible:
    items:
      - const: allwinner,sun20i-d1-codec
      - const: simple-mfd
      - const: syscon

  reg:
    maxItems: 1

  interrupts:
    maxItems: 1

  clocks:
    items:
      - description: Bus clock
      - description: ADC clock
      - description: DAC clock

  clock-names:
    items:
      - const: bus
      - const: adc
      - const: dac

  resets:
    maxItems: 1

  dmas:
    items:
      - description: ADC receive channel
      - description: DAC transmit channel

  dma-names:
    items:
      - const: rx
      - const: tx

  "#address-cells":
    const: 1

  "#size-cells":
    const: 1

  "#sound-dai-cells":
    const: 0

  ranges:
    maxItems: 1

  avcc-supply: true
  hpvcc-supply: true
  vdd33-supply: true

  audio-widgets:
    $ref: /schemas/types.yaml#/definitions/non-unique-string-array
    description:
      A list of widget type and name pairs.
      Types include Headphone, Line, Microphone, and Speaker.

  regulators@348:
    $ref: /schemas/regulator/allwinner,sun20i-d1-analog-ldos.yaml#

required:
  - compatible
  - reg
  - interrupts
  - clocks
  - clock-names
  - resets
  - dmas
  - dma-names
  - "#sound-dai-cells"

unevaluatedProperties: false
...
```
